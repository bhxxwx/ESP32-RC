/* Variable definitions for ESP32ULP linker
 * This file is generated automatically by esp32ulp_mapgen.py utility.
 */

PROVIDE ( ulp_continue = 0x50000094 );
PROVIDE ( ulp_dect_io = 0x500000b0 );
PROVIDE ( ulp_entry = 0x50000000 );
PROVIDE ( ulp_io_low_active = 0x50000074 );
PROVIDE ( ulp_io_number_active_high = 0x50000100 );
PROVIDE ( ulp_io_number_active_low = 0x500000c0 );
PROVIDE ( ulp_io_numbers_active_low = 0x500000bc );
PROVIDE ( ulp_is_ulp_wakeup = 0x500000ac );
PROVIDE ( ulp_read_done_active_low = 0x50000044 );
PROVIDE ( ulp_read_io_high_active_low = 0x50000038 );
PROVIDE ( ulp_read_io_loop_active_low = 0x50000020 );
PROVIDE ( ulp_wake_up = 0x50000098 );
PROVIDE ( ulp_wake_up_index = 0x500000b8 );
PROVIDE ( ulp_wake_up_io = 0x500000b4 );
